## conf/layer.conf
```bitbake
# We might have a conf and classes directory, append to BBPATH
BBPATH .= ":${LAYERDIR}"

# We have recipes directories, add to BBFILES
BBFILES += "${LAYERDIR}/recipes*/*/*.bb ${LAYERDIR}/recipes*/*/*.bbappend"

BBFILE_COLLECTIONS += "meta-maker"
BBFILE_PATTERN_meta-maker := "^${LAYERDIR}/"
BBFILE_PRIORITY_meta-maker = "7"

PREFERRED_VERSION_python3-werkzeug = "0.14.1"

# This should only be incremented on significant changes that will
# # cause compatibility issues with other layers
LAYERVERSION_meta-maker = "1"

LAYERDEPENDS_meta-maker = "core openembedded-layer meta-python perl-layer webserver"
LAYERSERIES_COMPAT_meta-maker = "zeus"
```
